/dts-v1/;
/plugin/;

/ {
	fragment@0 {
		target = <&dsi0>;
		__overlay__ {
			status = "disabled";
		};
	};

	fragment@1 {
		target = <&dp_intf0>;
		__overlay__ {
			status = "okay";
		};
	};

	fragment@2 {
		target = <&edp_tx>;
		__overlay__ {
			status = "okay";
		};
	};

	fragment@3 {
		target = <&edp_panel>;
		__overlay__ {
			status = "okay";
		};
	};
};

