## ubuntu/Kconfig
```kconfig
menu "Ubuntu Supplied Third-Party Device Drivers"


config UBUNTU_ODM_DRIVERS
	def_bool $(success,$(srctree)/debian/scripts/misc/arch-has-odm-enabled.sh $(DEB_ARCH))
	help
	  Turn on support for Ubuntu ODM supplied drivers

#
# NOTE: to allow drivers to be added and removed without causing merge
# collisions you should add new entries in the middle of the six lines
# of ## at the bottom of the list.  Always add three lines of ## above
# your new entry and maintain the six lines below.
#

##
##
##
source "ubuntu/mtk-apusys-driver/Kconfig"
##
##
##
source "ubuntu/mtk-mdp-driver/Kconfig"
##
##
##
source "ubuntu/mtk-vcodec-driver/Kconfig"
##
##
##
source "ubuntu/mtk-vcu-driver/Kconfig"
##
##
##
source "ubuntu/mtk-mali-gpu-driver/Mconfig"
##
##
##
source "ubuntu/ubuntu-host/Kconfig"
##
##
##
##
##
##

endmenu
```

## ubuntu/mtk-mdp-driver/mt8365/Kconfig
```kconfig
config VIDEO_MEDIATEK_MDP_MT8167
	tristate "Mediatek MDP driver for MT8167 SoC"
	depends on MTK_IOMMU || COMPILE_TEST
	depends on VIDEO_DEV && VIDEO_V4L2
	depends on ARCH_MEDIATEK || COMPILE_TEST
	depends on MTK_SMI || (COMPILE_TEST && MTK_SMI=n)
	depends on !VIDEO_MEDIATEK_MDP
	depends on VIDEO_MEDIATEK_VCU_MT8167
	depends on VIDEOBUF2_DMA_CONTIG
	depends on V4L2_MEM2MEM_DEV
	help
	    It is a v4l2 driver and present in Mediatek MT8173 SoCs.
	    The driver supports for scaling and color space conversion.

	    To compile this driver as a module, choose M here: the
	    module will be called mtk-mdp.
```

## ubuntu/mtk-vcodec-driver/mt8365/Kconfig
```kconfig
config VIDEO_MEDIATEK_VCODEC_MT8167
	tristate "Mediatek Video Codec driver for MT8167 SoC"
	depends on MTK_IOMMU || COMPILE_TEST
	depends on VIDEO_DEV && VIDEO_V4L2
	depends on ARCH_MEDIATEK || COMPILE_TEST
	depends on !VIDEO_MEDIATEK_VCODEC
	depends on VIDEO_MEDIATEK_VCU_MT8167
	depends on VIDEOBUF2_DMA_CONTIG
	depends on V4L2_MEM2MEM_DEV
	help
	    Mediatek MT8167 video codec driver provides HW capability to
	    encode and decode in a range of video formats
	    This driver rely on VPU driver to communicate with VPU.

	    To compile this driver as a module, choose M here: the
	    module will be called mtk-vcodec
```

## ubuntu/mtk-vcu-driver/mt8395/Kconfig
```kconfig
config VIDEO_MEDIATEK_VCU_MT8395
	tristate "Mediatek Video Compute Unit"
	depends on VIDEO_DEV && VIDEO_V4L2
	depends on ARCH_MEDIATEK || COMPILE_TEST
	help
	    This driver provides the interface to communicate with
	    the userspace daemons. This driver for hw video
	    codec embedded in Mediatek's MT8395 SOCs. It is able
	    to handle video decoding/encoding in a range of formats.

	    To compile this driver as a module, choose M here: the
	    module will be called mtk-vcu.
```
